## package/patchelf/Config.in
```kconfig
config BR2_PACKAGE_PATCHELF
	bool
	default y
	help
	  PatchELF is a small utility to modify the dynamic linker
	  and RPATH of ELF executables.

	  http://nixos.org/patchelf.html
```
